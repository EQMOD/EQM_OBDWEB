/**************************************************************************************************
  Filename:       ubl_aes_link.xcl
  Revised:        $Date: 2010-09-22 11:40:55 -0700 (Wed, 22 Sep 2010) $
  Revision:       $Revision: 23872 $

  Description:

  This is a linker command line file for the IAR XLINK tool for the CC2531/40,
  built with the General Options for the location of constants and strings
  configured to be "ROM mapped as data".

  This mapping is to build the encrypting/authenticating universal boot loader code for USB by MSD.


  Copyright 2012 Texas Instruments Incorporated. All rights reserved.

  IMPORTANT: Your use of this Software is limited to those specific rights
  granted under the terms of a software license agreement between the user
  who downloaded the software, his/her employer (which must be your employer)
  and Texas Instruments Incorporated (the "License").  You may not use this
  Software unless you agree to abide by the terms of the License. The License
  limits your use, and you acknowledge, that the Software may not be modified,
  copied or distributed unless embedded on a Texas Instruments microcontroller
  or used solely and exclusively in conjunction with a Texas Instruments radio
  frequency transceiver, which is integrated into your product.  Other than for
  the foregoing purpose, you may not use, reproduce, copy, prepare derivative
  works of, modify, distribute, perform, display or sell this Software and/or
  its documentation for any purpose.

  YOU FURTHER ACKNOWLEDGE AND AGREE THAT THE SOFTWARE AND DOCUMENTATION ARE
  PROVIDED “AS IS" WITHOUT WARRANTY OF ANY KIND, EITHER EXPRESS OR IMPLIED,
  INCLUDING WITHOUT LIMITATION, ANY WARRANTY OF MERCHANTABILITY, TITLE,
  NON-INFRINGEMENT AND FITNESS FOR A PARTICULAR PURPOSE. IN NO EVENT SHALL
  TEXAS INSTRUMENTS OR ITS LICENSORS BE LIABLE OR OBLIGATED UNDER CONTRACT,
  NEGLIGENCE, STRICT LIABILITY, CONTRIBUTION, BREACH OF WARRANTY, OR OTHER
  LEGAL EQUITABLE THEORY ANY DIRECT OR INDIRECT DAMAGES OR EXPENSES
  INCLUDING BUT NOT LIMITED TO ANY INCIDENTAL, SPECIAL, INDIRECT, PUNITIVE
  OR CONSEQUENTIAL DAMAGES, LOST PROFITS OR LOST DATA, COST OF PROCUREMENT
  OF SUBSTITUTE GOODS, TECHNOLOGY, SERVICES, OR ANY CLAIMS BY THIRD PARTIES
  (INCLUDING BUT NOT LIMITED TO ANY DEFENSE THEREOF), OR OTHER SIMILAR COSTS.

  Should you have any questions regarding your right to use this Software,
  contact Texas Instruments Incorporated at www.TI.com.

**************************************************************************************************/

////////////////////////////////////////////////////////////////////////////////
//
// Segment limits
//

//
// XDATA available to the program.
//
-D_XDATA_BEG=0x0000
-D_XDATA_END=0x1EFF

//
// The 8052 IDATA is overlayed on the SoC XDATA space from 0x1F00-0x1FFF.
//
-D_IDATA_END=0xFF              // Last address of Idata memory.

//
// CODE Root - Taking the first 2K of flash (the 1st page contains the INTVEC's).
//
-D_IVEC_BEG=0x0000
-D_IVEC_END=0x07FF

//
// CODE Banks - Taking pages 120-124
//
-D_BANK7_BEG=0x7C000        // Beginning byte address of page 120

-D_BANK7_END=0x7E7FF        // Ending byte address of page 124

//
// Register bank setup
//
-D?REGISTER_BANK=0             // Default register bank (0,1,2,3).
-D_REGISTER_BANK_BEG=0         // Start address for default register bank (00,08,10,18).

//
// PDATA page setup
//
-D?PBANK_NUMBER=00             // High byte of 16-bit address to the PDATA area.

//
// Virtual register setup
//

-D_BREG_BEG=0x00               // The bit address where the BREG segments starts.
                               // Must be placed on: _BREG_BEG%8=0 where _BREG_BEG <= 0x78.

-D?VB=0x20                     // ?VB is used when referencing BREG as whole byte.
                               // Must be placed on: ?VB=0x20+_BREG_BEG/8.

////////////////////////////////////////////////////////////////////////////////
//
// IDATA memory
//

// Setup "bit" segments (only for '__no_init bool' variables).
-Z(BIT)BREG=_BREG_BEG
-Z(BIT)BIT_N=0-7F

-Z(DATA)REGISTERS+8=_REGISTER_BANK_BEG
-Z(DATA)BDATA_Z,BDATA_N,BDATA_I=20-2F
-Z(DATA)VREG+_NR_OF_VIRTUAL_REGISTERS=08-7F
-Z(DATA)PSP,XSP=08-7F
-Z(DATA)DOVERLAY=08-7F
-Z(DATA)DATA_I,DATA_Z,DATA_N=08-7F

-U(IDATA)0-7F=(DATA)0-7F
-Z(IDATA)IDATA_I,IDATA_Z,IDATA_N=08-_IDATA_END
-Z(IDATA)ISTACK+_IDATA_STACK_SIZE#08-_IDATA_END
-Z(IDATA)IOVERLAY=08-FF

////////////////////////////////////////////////////////////////////////////////
//
// ROM memory
//

-Z(CODE)INTVEC=_IVEC_BEG
-Z(CODE)BIT_ID,BDATA_ID,DATA_ID,IDATA_ID,IXDATA_ID,PDATA_ID,XDATA_ID=_IVEC_BEG-_IVEC_END
-P(CODE)CSTART,RCODE,DIFUNCT,NEAR_CODE=_IVEC_BEG-_IVEC_END
-P(CODE)BANK_RELAYS=_IVEC_BEG-_IVEC_END

//
// Setup for constants located in code memory:
//
-P(CODE)CODE_C=_BANK7_BEG-_BANK7_END
//
// Define segments for const data in flash.
// First the segment with addresses as used by the program (flash mapped as XDATA)
-P(CONST)XDATA_ROM_C=0xC000-0xE7FF
//
// Then the segment with addresses as put in the hex file (flash bank 7)
-P(CODE)XDATA_ROM_C_FLASH=_BANK7_BEG-_BANK7_END
//
// Finally link these segments (XDATA_ROM_C_FLASH is the initializer segment for XDATA_ROM_C,
// we map the flash in the XDATA address range instead of copying the data to RAM)
-QXDATA_ROM_C=XDATA_ROM_C_FLASH

-P(CODE)BANKED_CODE=_IVEC_BEG-_IVEC_END,_BANK7_BEG-_BANK7_END

////////////////////////////////////////////////////////////////////////////////
//
// XDATA memory
//

-Z(XDATA)XSTACK+_XDATA_STACK_SIZE=_XDATA_BEG-_XDATA_END
-Z(XDATA)XDATA_Z,XDATA_I,PDATA_Z=_XDATA_BEG-_XDATA_END
-P(XDATA)XDATA_N=_XDATA_BEG-_XDATA_END

-cx51

////////////////////////////////////////////////////////////////////////////////
//
// Misc.
//

//
// Include the -M directive when generating a .hex file for banked code model:
//
-D_FIRST_BANK_ADDR=0x10000
//
-M(CODE)[(_CODEBANK_START+_FIRST_BANK_ADDR)-(_CODEBANK_END+_FIRST_BANK_ADDR)]*\
_NR_OF_BANKS+_FIRST_BANK_ADDR=0x8000
// Ignore the useless XLINK warning [w69] when building debug output with the -M option.
-ww69=i

//
// Fill code gaps with 0xFFFF so that the .hex image produced is full.
//
-HFFFF

//
////////////////////////////////////////////////////////////////////////////////
